## esp32/sdkconfig.defaults
```kconfig
# Common defaults
CONFIG_ESP_MAIN_TASK_STACK_SIZE=8192
CONFIG_COMPILER_CXX_EXCEPTIONS=n
CONFIG_LWIP_SO_REUSE=y
CONFIG_LOG_DEFAULT_LEVEL_INFO=y

# Custom partition table (4MB classic; S3 variants override via sdkconfig.defaults.<board>)
# app0/app1 = 1.75 MB each, spiffs = 384 KB (LittleFS), coredump = 64 KB
CONFIG_PARTITION_TABLE_CUSTOM=y
CONFIG_PARTITION_TABLE_CUSTOM_FILENAME="partitions/esp32dev.csv"
CONFIG_ESPTOOLPY_FLASHSIZE_4MB=y
CONFIG_ESPTOOLPY_FLASHSIZE="4MB"

# Task watchdog disabled — we use platform::yield() for cooperative scheduling
CONFIG_ESP_TASK_WDT_EN=n

# lwIP core locking — socket calls take the TCP/IP core mutex and run inline
# instead of context-switching to the tcpip_thread per call. Large win for the
# ArtNet send path (97 UDP packets per frame).
CONFIG_LWIP_TCPIP_CORE_LOCKING=y

# Larger TCP send buffer so the preview WebSocket frame (up to ~5.5 KB at the
# finest detail level) fits in one non-blocking write with comfortable headroom
# — avoids partial sends that would drop and reconnect the preview connection.
CONFIG_LWIP_TCP_SND_BUF_DEFAULT=11520

# WiFi
CONFIG_ESP_WIFI_ENABLED=y

# Ethernet — Olimex ESP32-Gateway (LAN8720 RMII)
CONFIG_ETH_USE_ESP32_EMAC=y
CONFIG_ETH_PHY_INTERFACE_RMII=y
CONFIG_ETH_PHY_ADDR=0
CONFIG_ETH_PHY_RST_GPIO=5
CONFIG_ETH_DMA_BUFFER_SIZE=512
CONFIG_ETH_DMA_RX_BUFFER_NUM=10
CONFIG_ETH_DMA_TX_BUFFER_NUM=10
```

## esp32/sdkconfig.defaults.16mb
```kconfig
# ESP32 classic with 16 MB flash (e.g. Serg boards, QuinLED Dig-Octa).
# Append to sdkconfig.defaults (later fragment wins): overrides the base 4 MB
# flash size + esp32dev.csv partition with a 16 MB layout. No PSRAM — this is a
# classic-ESP32 WiFi build; the win is bigger OTA slots + filesystem, not RAM.

# Custom partition table — shared 16 MB layout (app0/app1 = 4 MB each, spiffs
# ~7.9 MB). Chip-independent flash map; same file for S3-N16R8 and P4-NANO.
CONFIG_PARTITION_TABLE_CUSTOM=y
CONFIG_PARTITION_TABLE_CUSTOM_FILENAME="partitions/ota_16mb.csv"

# Flash size override (base default is 4MB). Only the choice symbol — the
# FLASHSIZE string is derived from it, matching the esp32s3-n16r8/n8r8 fragments.
CONFIG_ESPTOOLPY_FLASHSIZE_16MB=y
```

## esp32/sdkconfig.defaults.esp32p4-eth
```kconfig
# Waveshare ESP32-P4-NANO — Ethernet-only build (IP101 PHY).
#   Board: https://www.waveshare.com/wiki/ESP32-P4-Nano-StartPage
#   Schematic / pin map confirmed against the Waveshare wiki + the ESPHome
#   device page (devices.esphome.io/devices/waveshare-esp32-p4-nano).
#
# Layered onto sdkconfig.defaults by scripts/build/build_esp32.py.
#
# The RMII / PHY *pins* are NOT set here — they live in C (the per-target
# ethPins struct in src/platform/esp32/platform_config.h, read by ethInit),
# so the pin map stays in one place. This fragment only enables the EMAC + the
# RMII interface + flash / PSRAM / partition layout. (IP101 addr 1, MDC 31,
# MDIO 52, reset 51, external RMII clock IN on GPIO 50 — see the struct.)

# Custom partition table — shared 16 MB layout (app0/app1 = 4 MB each, spiffs
# ~7.9 MB). Chip-independent flash map; same file for classic-16mb and S3-N16R8.
CONFIG_PARTITION_TABLE_CUSTOM=y
CONFIG_PARTITION_TABLE_CUSTOM_FILENAME="partitions/ota_16mb.csv"

# Flash size override (P4-NANO ships 16 MB).
CONFIG_ESPTOOLPY_FLASHSIZE_16MB=y

# Target the earlier P4 silicon (rev <3.0). The v6.1 IDF defaults the minimum P4
# revision to v3.1 (ESP32P4_REV_MIN_301), which refuses to boot on the v0.x/v1.x
# P4 chips already in the field (e.g. a v1.x P4-NANO) — the bootloader rejects the
# chip at startup. IDF gates the sub-v3 revisions behind SELECTS_REV_LESS_V3
# (rev <3.0 and >=3.0 are "huge hardware difference", so a binary targets one or
# the other, not both); enable it, then pin the minimum to v0 to run on any
# pre-v3 P4. Revisit if/when the field moves to v3.x P4 silicon.
CONFIG_ESP32P4_SELECTS_REV_LESS_V3=y
CONFIG_ESP32P4_REV_MIN_0=y

# PSRAM (P4-NANO has 32 MB; the P4 uses a HEX/200 MHz PSRAM controller, not the
# S3's octal mode). Round 1 makes no large allocations, so PSRAM is enabled for
# later rounds but not relied on at boot.
CONFIG_SPIRAM=y

# Ethernet — on-chip EMAC + RMII. Pins are runtime config (ethConfig_ in C), not
# sdkconfig. RMII is the EMAC's only interface and the IDF default, so no
# CONFIG_ETH_PHY_INTERFACE_RMII (a non-existent symbol in IDF v6 — warned-on).
CONFIG_ETH_USE_ESP32_EMAC=y
CONFIG_ETH_DMA_BUFFER_SIZE=512
CONFIG_ETH_DMA_RX_BUFFER_NUM=10
CONFIG_ETH_DMA_TX_BUFFER_NUM=10

# MoonLive native codegen needs an executable heap (allocExec → MALLOC_CAP_EXEC). Like the
# S3, the P4 has hardware memory protection (PMP) that IDF couples to disabling the exec
# heap, so disable memprot to make MALLOC_CAP_EXEC available — the standard ESP32-JIT config.
# Safety for scripted code is the staged bounds/watchdog checks, not the hardware W^X wall.
# (Same rationale as sdkconfig.defaults.esp32s3-n16r8.)
CONFIG_ESP_SYSTEM_MEMPROT_FEATURE=n
CONFIG_HEAP_HAS_EXEC_HEAP=y
```

## esp32/sdkconfig.defaults.esp32p4-eth-wifi
```kconfig
# Waveshare ESP32-P4-NANO: Ethernet + WiFi build.
#   Board: https://www.waveshare.com/wiki/ESP32-P4-Nano-StartPage
#
# Layered onto sdkconfig.defaults + sdkconfig.defaults.esp32p4-eth by
# scripts/build/build_esp32.py. The eth fragment brings the EMAC / RMII / flash /
# PSRAM / partition layout; this fragment adds WiFi over the on-board ESP32-C6
# co-processor.
#
# The P4 has no native radio. WiFi comes from the C6 reached over SDIO, presented
# to the P4 as the standard esp_wifi_* API by the esp_wifi_remote + esp_hosted
# managed components (pulled P4-only via the `rules` gate in main/idf_component.yml).
# This is a DELIBERATE v6.0-floor exception (see docs/building.md § ESP-IDF version).
# No bring-up code is needed in the firmware: esp_hosted self-initialises at boot
# via a constructor and connects to the C6 on its own. ensureWifiInit() in
# src/platform/esp32/platform_esp32.cpp explicitly does NOT call esp_hosted_init /
# connect_to_slave (an earlier prelude that did was removed: it reset the slave and
# tore down the live SDIO link, bench-proven 2026-06-12). The co-processor firmware
# read-out is gated on platform::hasWifiCoprocessor.
#
# Values below mirror Espressif's own P4 reference fragment:
#   managed_components/espressif__esp_hosted/examples/host_network_split__power_save/
#   sdkconfig.defaults.esp32p4 (+ the example's shared sdkconfig.defaults).

# --- Co-processor = ESP32-C6. Two SEPARATE Kconfig choices must both point at the
# C6, in this order, or the build fails:
#   1. SLAVE_IDF_TARGET_ESP32C6 (esp_wifi_remote's slave select). It auto-defaults
#      to C6 on a P4, but esp_hosted's own CP-target choice does NOT track it, so
#      we set it explicitly to be unambiguous.
#   2. ESP_HOSTED_CP_TARGET_ESP32C6 (esp_hosted's co-processor choice). This option
#      `depends on SLAVE_IDF_TARGET_ESP32C6` — so without (1), only the dependency-
#      free ESP32-H2 option is selectable and the choice silently falls to H2 (a
#      WiFi-less part). That cascade is what dropped FUNC_BOARD to _NONE and left
#      the WIFI_RMT_* symbols undefined (the build failure chased down here).
CONFIG_SLAVE_IDF_TARGET_ESP32C6=y
CONFIG_ESP_HOSTED_CP_TARGET_ESP32C6=y

# --- Co-processor board preset. With the C6 target selected above, the "P4
# Function EV Board" preset becomes available and configures the SDIO transport +
# pins (CLK 18 / CMD 19 / D0-D3 14-17 / slave-reset 54), which match the NANO.
# BENCH-VERIFY: if connect-to-slave fails, the NANO may differ from the EV board
# preset; fall back to explicit SDIO pin config then.
CONFIG_ESP_HOSTED_P4_DEV_BOARD_FUNC_BOARD=y

# --- Remote WiFi RX/TX buffer config. esp_wifi_remote's WIFI_INIT_CONFIG_DEFAULT()
# reads these CONFIG_WIFI_RMT_* symbols (the remote counterparts of the native
# CONFIG_ESP_WIFI_* buffers); without them the macro fails to compile. Values from
# the reference fragment.
CONFIG_WIFI_RMT_STATIC_RX_BUFFER_NUM=10
CONFIG_WIFI_RMT_DYNAMIC_RX_BUFFER_NUM=32
CONFIG_WIFI_RMT_DYNAMIC_TX_BUFFER_NUM=32
CONFIG_WIFI_RMT_AMPDU_TX_ENABLED=y
CONFIG_WIFI_RMT_TX_BA_WIN=32
CONFIG_WIFI_RMT_AMPDU_RX_ENABLED=y
CONFIG_WIFI_RMT_RX_BA_WIN=16
```

## esp32/sdkconfig.defaults.esp32s3-n16r8
```kconfig
# ESP32-S3-N16R8 (16 MB flash, 8 MB PSRAM)
# Append to sdkconfig.defaults or copy as sdkconfig.defaults

# Custom partition table — shared 16 MB layout (app0/app1 = 4 MB each, spiffs
# ~7.9 MB). Chip-independent flash map; same file for classic-16mb and P4-NANO.
CONFIG_PARTITION_TABLE_CUSTOM=y
CONFIG_PARTITION_TABLE_CUSTOM_FILENAME="partitions/ota_16mb.csv"

# Flash size override (default is 2MB on ESP32-S3)
CONFIG_ESPTOOLPY_FLASHSIZE_16MB=y

# PSRAM
CONFIG_SPIRAM=y
CONFIG_SPIRAM_MODE_OCT=y
```

## esp32/sdkconfig.defaults.esp32s3-n8r8
```kconfig
# ESP32-S3-N8R8 (8 MB flash, 8 MB PSRAM)
# Append to sdkconfig.defaults (later fragment wins, overriding the base 4 MB +
# esp32dev.csv partition the classic default sets).

# Custom partition table — 8MB layout (app0/app1 = 3 MB each, spiffs = ~1.9 MB)
CONFIG_PARTITION_TABLE_CUSTOM=y
CONFIG_PARTITION_TABLE_CUSTOM_FILENAME="partitions/esp32s3_n8r8.csv"

# Flash size override (default is 2MB on ESP32-S3)
CONFIG_ESPTOOLPY_FLASHSIZE_8MB=y

# PSRAM — same 8 MB octal as N16R8
CONFIG_SPIRAM=y
CONFIG_SPIRAM_MODE_OCT=y
```

## esp32/sdkconfig.defaults.esp32s31
```kconfig
# Espressif ESP32-S31 Function-CoreBoard-1 — WiFi 6 + Ethernet, all in one image.
#   Board: the Espressif ESP32-S31 Function-CoreBoard (RISC-V dual-core, Wi-Fi 6,
#   BT 5.4, on-chip 1 Gbps EMAC, 16 MB flash, PSRAM).
#
# Layered onto sdkconfig.defaults by scripts/build/build_esp32.py.
#
# The RMII / PHY *pins* are NOT set here — they live in C (the per-target ethPins
# struct in src/platform/esp32/platform_config.h, read by ethInit), so the pin map
# stays in one place. This fragment enables the EMAC + flash / PSRAM / partition
# layout + the exec heap; the same shape as the P4 (the other on-chip-EMAC,
# RISC-V, PSRAM target).

# Custom partition table — shared 16 MB layout (app0/app1 = 4 MB each, spiffs
# ~7.9 MB). Chip-independent flash map; the same file every 16 MB target uses.
CONFIG_PARTITION_TABLE_CUSTOM=y
CONFIG_PARTITION_TABLE_CUSTOM_FILENAME="partitions/ota_16mb.csv"

# Flash size override (the CoreBoard ships 16 MB).
CONFIG_ESPTOOLPY_FLASHSIZE_16MB=y

# PSRAM — the S31 has a DMA-capable PSRAM with a dedicated LDO (SOC_SPIRAM_SUPPORTED,
# SOC_PSRAM_HAS_DEDICATED_LDO). Enabled for the large buffers later rounds allocate;
# not relied on at boot.
CONFIG_SPIRAM=y

# Ethernet — on-chip EMAC + RMII (SOC_EMAC_SUPPORTED, SOC_EMAC_SUPPORT_1000M). Pins
# are runtime config (ethConfig_ in C), not sdkconfig. RMII is the EMAC's default
# interface, so no CONFIG_ETH_PHY_INTERFACE_RMII (a non-existent symbol in IDF v6).
CONFIG_ETH_USE_ESP32_EMAC=y
CONFIG_ETH_DMA_BUFFER_SIZE=512
CONFIG_ETH_DMA_RX_BUFFER_NUM=10
CONFIG_ETH_DMA_TX_BUFFER_NUM=10

# MoonLive native codegen needs an executable heap (allocExec → MALLOC_CAP_EXEC). Like the
# S3 and P4, the S31 has hardware memory protection that IDF couples to disabling the exec
# heap, so disable memprot to make MALLOC_CAP_EXEC available — the standard ESP32-JIT config.
# Safety for scripted code is the staged bounds/watchdog checks, not the hardware W^X wall.
# (Same rationale as sdkconfig.defaults.esp32p4-eth.)
CONFIG_ESP_SYSTEM_MEMPROT_FEATURE=n
CONFIG_HEAP_HAS_EXEC_HEAP=y
```

## esp32/sdkconfig.defaults.eth
```kconfig
# Ethernet (internal EMAC, RMII) — enables the RMII *driver* for the classic
# ESP32 / P4. Layered onto sdkconfig.defaults by scripts/build/build_esp32.py.
#
# Only the driver enable + DMA buffers live here (compile-time). The PHY addr,
# reset GPIO, MDC/MDIO and RMII clock are RUNTIME config now — set per board in
# boards.json (→ NetworkModule → ethInit reads them), seeded from the per-chip
# default in platform_config.h (Olimex map on classic, IP101 on P4). So no
# CONFIG_ETH_PHY_ADDR / _RST_GPIO here: they were dead (ethInit always overrode
# them from the C++ struct) and a stale value would only mislead.

# RMII is the only interface the internal EMAC supports and the IDF default
# (ETH_ESP32_EMAC_DEFAULT_CONFIG sets .interface = EMAC_DATA_INTERFACE_RMII), so no
# CONFIG_ETH_PHY_INTERFACE_RMII here — that symbol doesn't exist in IDF v6 (it only
# produced an "unknown kconfig symbol" warning).
CONFIG_ETH_USE_ESP32_EMAC=y
CONFIG_ETH_DMA_BUFFER_SIZE=512
CONFIG_ETH_DMA_RX_BUFFER_NUM=10
CONFIG_ETH_DMA_TX_BUFFER_NUM=10
```

## esp32/sdkconfig.defaults.olimex_gw
```kconfig
# Olimex ESP32-Gateway — LAN8720 RMII
# Append to sdkconfig.defaults or copy as sdkconfig.defaults

CONFIG_ETH_USE_ESP32_EMAC=y
CONFIG_ETH_PHY_INTERFACE_RMII=y
CONFIG_ETH_DMA_BUFFER_SIZE=512
CONFIG_ETH_DMA_RX_BUFFER_NUM=10
CONFIG_ETH_DMA_TX_BUFFER_NUM=10
```

## esp32/sdkconfig.defaults.wt32eth01
```kconfig
# WT32-ETH01 V1.4 — LAN8720 RMII
# Append to sdkconfig.defaults or copy as sdkconfig.defaults

CONFIG_ETH_USE_ESP32_EMAC=y
CONFIG_ETH_PHY_INTERFACE_RMII=y
CONFIG_ETH_RMII_CLK_OUTPUT=y
CONFIG_ETH_RMII_CLK_OUT_GPIO=0
CONFIG_ETH_DMA_BUFFER_SIZE=512
CONFIG_ETH_DMA_RX_BUFFER_NUM=10
CONFIG_ETH_DMA_TX_BUFFER_NUM=10
```
